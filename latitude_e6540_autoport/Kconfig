## latitude_e6540_autoport/Kconfig
```kconfig
## SPDX-License-Identifier: GPL-2.0-only

if BOARD_DELL_LATITUDE_E6540

config BOARD_SPECIFIC_OPTIONS
	def_bool y
	select BOARD_ROMSIZE_KB_12288
	select EC_ACPI
	select HAVE_ACPI_RESUME
	select HAVE_ACPI_TABLES
	select MAINBOARD_HAS_LIBGFXINIT # FIXME: check this
	select NORTHBRIDGE_INTEL_HASWELL
	select SERIRQ_CONTINUOUS_MODE
	select SOUTHBRIDGE_INTEL_LYNXPOINT
	select SYSTEM_TYPE_LAPTOP

config MAINBOARD_DIR
	string
	default "dell/latitude_e6540"

config MAINBOARD_PART_NUMBER
	string
	default "Latitude E6540"

config VGA_BIOS_ID
	string
	default "8086,0416"

config USBDEBUG_HCD_INDEX # FIXME: check this
	int
	default 2
endif
```
